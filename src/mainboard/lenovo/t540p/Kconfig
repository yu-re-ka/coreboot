## src/mainboard/lenovo/t540p/Kconfig
```kconfig
if BOARD_LENOVO_THINKPAD_T540P

config BOARD_SPECIFIC_OPTIONS
	def_bool y
	select BOARD_ROMSIZE_KB_12288
	select EC_LENOVO_H8
	select EC_LENOVO_PMH7
	select H8_HAS_BAT_THRESHOLDS_IMPL
	select H8_HAS_PRIMARY_FN_KEYS
	select HAVE_ACPI_RESUME
	select HAVE_ACPI_TABLES
	select HAVE_CMOS_DEFAULT
	select HAVE_OPTION_TABLE
	select INTEL_INT15
	select MAINBOARD_HAS_LIBGFXINIT # FIXME: check this
	select MAINBOARD_HAS_TPM1
	select MAINBOARD_USES_IFD_GBE_REGION
	select MEMORY_MAPPED_TPM
	select NORTHBRIDGE_INTEL_HASWELL
	select NO_UART_ON_SUPERIO
	select SERIRQ_CONTINUOUS_MODE
	select SOUTHBRIDGE_INTEL_LYNXPOINT
	select SYSTEM_TYPE_LAPTOP

config MAINBOARD_DIR
	default "lenovo/t540p"

config MAINBOARD_PART_NUMBER
	default "ThinkPad T540p"

config VGA_BIOS_ID
	string
	default "8086,0416"

config USBDEBUG_HCD_INDEX # FIXME: check this
	int
	default 2

config DRIVER_LENOVO_SERIALS
	bool
	default n

config PS2K_EISAID
	default "LEN0071"

config PS2M_EISAID
	default "LEN0034"

config THINKPADEC_HKEY_EISAID
	default "LEN0068"

endif
```
